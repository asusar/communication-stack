AUTOSAR XML (schema 4-3-0)
package /EcucDefs
  module config Can
    CanGeneral ()
      ecuc numerical param value CanDevErrorDetect: value=False
      ecuc numerical param value CanMultiplexedTransmission: value=False
      float CanTimeoutDuration: value=0
      8 x ecuc numerical param value:
        CanMainFunctionWakeupPeriod: value=0
        CanMainFunctionModePeriod: value=0
        CanIndex: value=0
        CanVersionInfoApi: value=False
        CanSetBaudrateApi: value=False
        CanPublicIcomSupport: value=False
        CanLPduReceiveCalloutFunction
        CanMainFunctionBusoffPeriod
      ecuc reference value CanOsCounterRef
      ecuc reference value CanSupportTTCANRef
      ecuc reference value CanSupportTTCANRef
    container CanConfigSet
      3 x :
        CanController1
          ecuc numerical param value CanControllerId: value=0
          ecuc numerical param value CanControllerActivation: value=False
          ecuc numerical param value CanControllerBaseAddress: value=0
          ecuc textual param value CanTxProcessing0: value=INTERRUPT
          ecuc textual param value CanRxProcessing0: value=INTERRUPT
          sub containers CanController1BaudrateConfig_1
            6 x ecuc numerical param value:
              CanControllerBaudRate: value=500
              CanControllerPropSeg: value=2
              CanControllerSeg1: value=6
              CanControllerSeg2: value=7
              CanControllerSyncJumpWidth: value=4
              CanControllerBaudRateConfigID: value=0
          ecuc reference value CanControllerDefaultBaudrate: value=BaudRate Config1
          ecuc reference value CanCpuClockRef
          ecuc reference value CanWakeupSourceRef
        CanController2
          ecuc numerical param value CanControllerId: value=1
          ecuc numerical param value CanControllerActivation: value=False
          ecuc numerical param value CanControllerBaseAddress: value=40041000
          ecuc textual param value CanTxProcessing1: value=INTERRUPT
          ecuc textual param value CanRxProcessing1: value=INTERRUPT
          sub containers CanController2BaudrateConfig_1
            6 x ecuc numerical param value:
              CanControllerBaudRate: value=500
              CanControllerPropSeg: value=2
              CanControllerSeg1: value=6
              CanControllerSeg2: value=7
              CanControllerSyncJumpWidth: value=4
              CanControllerBaudRateConfigID: value=0
          ecuc reference value CanControllerDefaultBaudrate: value=BaudRate Config1
          ecuc reference value CanCpuClockRef
          ecuc reference value CanWakeupSourceRef
        CanHardwareObject1
          ecuc textual param value CanHandleType: value=FULL
          ecuc textual param value CanObjectType: value=TRANSMIT
          ecuc textual param value CanIdType: value=STANDARD
          6 x ecuc numerical param value:
            CanObjectId: value=0
            CanFdPaddingValue: value=0
            CanTriggerTransmitEnable: value=False
            CanHwObjectCount: value=1
            CanControllerRef: value=Controller1
            CanMainFunctionBusoffPeriod_1
