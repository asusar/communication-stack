AUTOSAR XML (schema 4-3-0)
package /EcucDefs
  module config Can
    CanGeneral ()
      ecuc numerical param value CanDevErrorDetect: value=False
      ecuc numerical param value CanMultiplexedTransmission: value=False
      float CanTimeoutDuration: value=1
      5 x ecuc numerical param value:
        CanMainFunctionModePeriod: value=1
        CanIndex: value=0
        CanVersionInfoApi: value=False
        CanSetBaudrateApi: value=True
        CanMainFunctionBusoffPeriod: value=1
    container CanConfigSet
      4 x :
        CanController1
          ecuc numerical param value CanControllerId: value=0
          ecuc numerical param value CanControllerActivation: value=False
          ecuc numerical param value CanControllerBaseAddress: value=40040000
          ecuc textual param value CanTxProcessing0: value=INTERRUPT
          ecuc textual param value CanRxProcessing0: value=INTERRUPT
          ecuc textual param value CanBusoffProcessing0: value=INTERRUPT
          sub containers CanController1BaudrateConfig_1
            12 x ecuc numerical param value:
              CanControllerBaudRate: value=500
              CanControllerPropSeg: value=2
              CanControllerSeg1: value=6
              CanControllerSeg2: value=7
              CanControllerSyncJumpWidth: value=4
              CanControllerBaudRateConfigID: value=0
              CanControllerBaudRate: value=200
              CanControllerPropSeg: value=2
              CanControllerSeg1: value=3
              CanControllerSeg2: value=4
              CanControllerSyncJumpWidth: value=2
              CanControllerBaudRateConfigID: value=1
          ecuc reference value CanControllerDefaultBaudrate: value=BaudRate Config1
          ecuc reference value CanCpuClockRef
        CanController2
          ecuc numerical param value CanControllerId: value=1
          ecuc numerical param value CanControllerActivation: value=False
          ecuc numerical param value CanControllerBaseAddress: value=40041000
          ecuc textual param value CanTxProcessing1: value=INTERRUPT
          ecuc textual param value CanRxProcessing1: value=INTERRUPT
          ecuc textual param value CanBusoffProcessing1: value=INTERRUPT
          sub containers CanController2BaudrateConfig_1
            6 x ecuc numerical param value:
              CanControllerBaudRate: value=300
              CanControllerPropSeg: value=2
              CanControllerSeg1: value=6
              CanControllerSeg2: value=7
              CanControllerSyncJumpWidth: value=4
              CanControllerBaudRateConfigID: value=0
          ecuc reference value CanControllerDefaultBaudrate: value=BaudRate Config1
          ecuc reference value CanCpuClockRef
        CanHardwareObject1
          ecuc textual param value CanHandleType: value=FULL
          ecuc textual param value CanObjectType: value=TRANSMIT
          ecuc textual param value CanIdType: value=STANDARD
          4 x ecuc numerical param value:
            CanObjectId: value=0
            CanTriggerTransmitEnable: value=False
            CanHwObjectCount: value=1
            CanControllerRef: value=Controller1
        CanHardwareObject2
          ecuc textual param value CanHandleType: value=FULL
          ecuc textual param value CanObjectType: value=RECEIVE
          ecuc textual param value CanIdType: value=STANDARD
          7 x ecuc numerical param value:
            CanObjectId: value=1
            CanTriggerTransmitEnable: value=False
            CanHwObjectCount: value=1
            CanControllerRef: value=Controller1
            CanHw2Filter_1
            CanHwFilterMask: value=FFFFFFFF
            CanHwFilterCode: value=0
