AUTOSAR XML (schema 4-3-0)
package /EcucDefs
  module config Can
    CanGeneral ()
    container CanConfigSet
